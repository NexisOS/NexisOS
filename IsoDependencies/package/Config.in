## IsoDependencies/package/nexpm/Config.in
```kconfig
config BR2_PACKAGE_NEXPM
	bool "nexpm - NexisOS Package Manager"
	help
	  Nexpm is the Rust-based package manager for NexisOS.
```

## depends/configs/NexisOS_x86_64_defconfig
```kconfig
# Architecture
BR2_x86_64=y

BR2_INIT_BUSYBOX=y
BR2_SYSTEM_DHCP="eth0"

# Root FS formats
BR2_TARGET_ROOTFS_ISO9660=y
BR2_TARGET_ROOTFS_ISO9660_HYBRID=y
BR2_TARGET_ROOTFS_ISO9660_COMPRESSION_XZ=y
BR2_TARGET_ROOTFS_TAR=y
BR2_TARGET_ROOTFS_EXT2=y

# Shell and core utilities
BR2_PACKAGE_BUSYBOX=y

# Installer tools
BR2_PACKAGE_TAR=y
BR2_PACKAGE_UTIL_LINUX=y
BR2_PACKAGE_UTIL_LINUX_PARTED=y
BR2_PACKAGE_E2FSPROGS_MKFS=y
BR2_PACKAGE_XFSPROGS=y
BR2_PACKAGE_BTRFS_PROGS=y     # Add Btrfs utilities for installer support

# Networking + secure download (minimal TLS)
BR2_PACKAGE_IFUPDOWN_SCRIPTS=y
BR2_PACKAGE_DHCPCD=y
BR2_PACKAGE_MBEDTLS=y
BR2_PACKAGE_CA_CERTIFICATES=y

# nexpm package manager
BR2_PACKAGE_NEXPM=y
BR2_PACKAGE_HOST_RUSTC=y

# GRUB (UEFI + BIOS boot for x86_64)
BR2_PACKAGE_GRUB2=y
BR2_PACKAGE_GRUB2_TARGET_I386_PC=y     # BIOS bootloader support (legacy 64-bit BIOS)
BR2_PACKAGE_GRUB2_TARGET_X86_64_EFI=y # UEFI bootloader support
BR2_PACKAGE_EFIBOOTMGR=y

# Overlay (installer scripts, etc.)
BR2_ROOTFS_OVERLAY="board/nexisos/overlay"

# Kernel
BR2_LINUX_KERNEL=y
BR2_LINUX_KERNEL_CUSTOM_VERSION=y
BR2_LINUX_KERNEL_CUSTOM_VERSION_VALUE="6.6.30"
BR2_LINUX_KERNEL_USE_CUSTOM_CONFIG=y
BR2_LINUX_KERNEL_CUSTOM_CONFIG_FILE="board/nexisos/linux-x86_64.config"
BR2_LINUX_KERNEL_INSTALL_TARGET=y

# Toolchain (optimized for size)
BR2_TOOLCHAIN_BUILDROOT_MUSL=y

# Size optimization
BR2_STRIP_strip=y
BR2_STRIP_EXCLUDE_FILES=""
BR2_ENABLE_LOCALE_PURGE=y
BR2_GENERATE_LOCALE="C en_US.UTF-8"
```

## distroConfigs/aarch64/NexisOS_aarch64_defconfig
```kconfig
# Architecture
BR2_aarch64=y

BR2_INIT_BUSYBOX=y
BR2_PACKAGE_BUSYBOX_WGET=y
BR2_SYSTEM_DHCP="eth0"

# Root FS formats
BR2_TARGET_ROOTFS_ISO9660=y
BR2_TARGET_ROOTFS_ISO9660_HYBRID=y
BR2_TARGET_ROOTFS_ISO9660_COMPRESSION_XZ=y
BR2_TARGET_ROOTFS_TAR=y
BR2_TARGET_ROOTFS_EXT2=y

# Shell and core utilities
BR2_PACKAGE_BUSYBOX=y

# Installer tools
BR2_PACKAGE_TAR=y
BR2_PACKAGE_UTIL_LINUX=y
BR2_PACKAGE_UTIL_LINUX_PARTED=y
BR2_PACKAGE_E2FSPROGS_MKFS=y
BR2_PACKAGE_XFSPROGS=y
BR2_PACKAGE_BTRFS_PROGS=y         # Added Btrfs utilities for installer support

# Networking + secure download (minimal TLS)
BR2_PACKAGE_IFUPDOWN_SCRIPTS=y
BR2_PACKAGE_DHCPCD=y
BR2_PACKAGE_MBEDTLS=y
BR2_PACKAGE_CA_CERTIFICATES=y

# GRUB (UEFI only for aarch64)
BR2_PACKAGE_GRUB2=y
BR2_PACKAGE_GRUB2_TARGET_AARCH64_EFI=y
BR2_PACKAGE_EFIBOOTMGR=y

# Overlay (installer scripts, etc.)
BR2_ROOTFS_OVERLAY="board/nexisos/overlay"

# Kernel
BR2_LINUX_KERNEL=y
BR2_LINUX_KERNEL_CUSTOM_VERSION=y
BR2_LINUX_KERNEL_CUSTOM_VERSION_VALUE="6.6.30"
BR2_LINUX_KERNEL_USE_CUSTOM_CONFIG=y
BR2_LINUX_KERNEL_CUSTOM_CONFIG_FILE="board/nexisos/linux-aarch64.config"
BR2_LINUX_KERNEL_INSTALL_TARGET=y

# Toolchain (optimized for size)
BR2_TOOLCHAIN_BUILDROOT_MUSL=y

# Size optimization
BR2_STRIP_strip=y
BR2_STRIP_EXCLUDE_FILES=""
BR2_ENABLE_LOCALE_PURGE=y
BR2_GENERATE_LOCALE="C en_US.UTF-8"
```

## distroConfigs/buildroot-packages/nexis_init/Config.in
```kconfig
config BR2_PACKAGE_NEXIS_INIT
	bool "nexis_init"
	depends on BR2_PACKAGE_HOST_RUSTC
	select BR2_PACKAGE_NEXIS_COMMON
	help
	  NexisOS init system - the initialization and boot manager
	  for NexisOS.

	  https://github.com/yourusername/NexisOS
```

## distroConfigs/buildroot-packages/nexis_pm/Config.in
```kconfig
config BR2_PACKAGE_NEXIS_PM
	bool "nexis_pm"
	depends on BR2_PACKAGE_HOST_RUSTC
	select BR2_PACKAGE_NEXIS_COMMON
	help
	  NexisOS package manager - declarative, reproducible package
	  management system with support for generations, rollbacks,
	  and fleet management.

	  https://github.com/yourusername/NexisOS
```

## distroConfigs/buildroot-packages/nexis_scan/Config.in
```kconfig
config BR2_PACKAGE_NEXIS_SCAN
	bool "nexis_scan"
	depends on BR2_PACKAGE_HOST_RUSTC
	select BR2_PACKAGE_NEXIS_COMMON
	help
	  NexisOS system scanner - analyzes and reports system
	  configuration and state.

	  https://github.com/yourusername/NexisOS
```

## distroConfigs/configs/NexisOS_x86_64_defconfig
```kconfig
# Architecture
BR2_x86_64=y

# Speed up build: enable ccache
BR2_CCACHE=y

# Use persistent download dir to avoid re-downloads
BR2_DOWNLOAD_DIR="/home/user/buildroot-dl"

# Disable debug info for faster build and smaller images
BR2_DEBUG_INFORMATION=n

# Use internal toolchain for faster build (set to y if you want external toolchain)
BR2_TOOLCHAIN_EXTERNAL=n

# Disable reproducible builds to speed up build time (set y if you want bit-identical builds)
BR2_REPRODUCIBLE=n

# Init system
BR2_INIT_BUSYBOX=y
BR2_SYSTEM_DHCP="eth0"

# Root FS formats
BR2_TARGET_ROOTFS_ISO9660=y
BR2_TARGET_ROOTFS_ISO9660_HYBRID=y
BR2_TARGET_ROOTFS_ISO9660_COMPRESSION_XZ=y
BR2_TARGET_ROOTFS_TAR=y
BR2_TARGET_ROOTFS_EXT2=y

# Shell and core utilities
BR2_PACKAGE_BUSYBOX=y

# Disable Busybox docs and SUID to speed build and reduce image size
BR2_PACKAGE_BUSYBOX_SHOW_DOCS=n
BR2_PACKAGE_BUSYBOX_SHOW_SUID=n

# Installer tools
BR2_PACKAGE_TAR=y
BR2_PACKAGE_UTIL_LINUX=y
BR2_PACKAGE_UTIL_LINUX_PARTED=y
BR2_PACKAGE_E2FSPROGS_MKFS=y
BR2_PACKAGE_XFSPROGS=y
BR2_PACKAGE_BTRFS_PROGS=y     # Btrfs utilities for installer support

# Networking + minimal TLS support for secure downloads
BR2_PACKAGE_IFUPDOWN_SCRIPTS=y
BR2_PACKAGE_DHCPCD=y
BR2_PACKAGE_MBEDTLS=y
BR2_PACKAGE_CA_CERTIFICATES=y

# nexpm package manager + Rust compiler (needed for nexpm build)
BR2_PACKAGE_NEXPM=y
BR2_PACKAGE_HOST_RUSTC=y

# GRUB bootloader (BIOS + UEFI for x86_64)
BR2_PACKAGE_GRUB2=y
BR2_PACKAGE_GRUB2_TARGET_I386_PC=y     # BIOS bootloader (legacy 64-bit BIOS)
BR2_PACKAGE_GRUB2_TARGET_X86_64_EFI=y # UEFI bootloader
BR2_PACKAGE_EFIBOOTMGR=y

# Overlay (installer scripts, configs, etc.)
BR2_ROOTFS_OVERLAY="board/nexisos/overlay"

# Linux kernel config
BR2_LINUX_KERNEL=y
BR2_LINUX_KERNEL_CUSTOM_VERSION=y
BR2_LINUX_KERNEL_CUSTOM_VERSION_VALUE="6.6.30"
BR2_LINUX_KERNEL_USE_CUSTOM_CONFIG=y
BR2_LINUX_KERNEL_CUSTOM_CONFIG_FILE="board/nexisos/linux-x86_64.config"
BR2_LINUX_KERNEL_INSTALL_TARGET=y

# Toolchain optimized for size
BR2_TOOLCHAIN_BUILDROOT_MUSL=y

# Strip binaries to reduce size
BR2_STRIP_strip=y
BR2_STRIP_EXCLUDE_FILES=""

# Locale optimizations
BR2_ENABLE_LOCALE_PURGE=y
BR2_GENERATE_LOCALE="C en_US.UTF-8"
```
